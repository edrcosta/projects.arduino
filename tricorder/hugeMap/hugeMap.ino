/*
  Huge map Arduboy demo.

  author: Miloslav Ciz
  license: CC0 1.0
*/

#include <Arduboy2.h>
#include "map.h"

Arduboy2 arduboy;

const unsigned char PROGMEM tiles[] =
{
  16, 16,
  0xff, 0xff, 0xff, 0xbf, 0xdf, 0xbf, 0xdf, 0xef, 0xff, 0xff, 0xff, 0x7f, 0xbf, 0x7f, 0xff, 0xff, 
  0xff, 0xff, 0xff, 0xf7, 0xeb, 0xf7, 0xff, 0xff, 0xff, 0xff, 0xff, 0xff, 0xfe, 0xff, 0xff, 0xff, 
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  0xa1, 0xa1, 0xa0, 0xa0, 0xa0, 0xb0, 0xd0, 0xd8, 0xec, 0xf6, 0xfb, 0xfb, 0xfc, 0xff, 0xff, 0xff, 
};

int16_t viewX, viewY;

bool btn(int b)
{
  return arduboy.justPressed(b) || (arduboy.pressed(b) && arduboy.everyXFrames(5));
}

void setup()
{
  viewX = 737 * 16;
  viewY = 665 * 16;
  arduboy.begin();
  arduboy.setFrameRate(255);
}

void loop()
{
  if (!(arduboy.nextFrame()))
    return;

  arduboy.clear();
  arduboy.pollButtons();
 
  int16_t camSpeed = 3;

  if (arduboy.pressed(A_BUTTON))
    camSpeed = 16;

  if (btn(UP_BUTTON))
    viewY -= camSpeed;
  else if (btn(DOWN_BUTTON))
    viewY += camSpeed;

  if (btn(RIGHT_BUTTON))
    viewX += camSpeed;
  else if (btn(LEFT_BUTTON))
    viewX -= camSpeed;

  if (viewX < 0)
    viewX = 0;
  else if (viewX > 1024 * 16)
    viewX = 1024 * 16;

  if (viewY < 0)
    viewY = 0;
  else if (viewY > 1024 * 16)
    viewY = 1024 * 16;

  int16_t tileX = viewX / 16;
  int16_t tileY = viewY / 16;
  int16_t fractX = viewX % 16;
  int16_t fractY = viewY % 16;

  for (int16_t y = 0; y < 5; ++y)
    for (int16_t x = 0; x < 9; ++x)
      Sprites::drawOverwrite(x * 16 - fractX,y * 16 - fractY,tiles,getMapTile(tileX + x,tileY + y));

  arduboy.print(tileX);
  arduboy.print(' ');
  arduboy.print(tileY);

  arduboy.display();
}
